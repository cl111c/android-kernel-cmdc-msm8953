## drivers/platform/cmcc/Kconfig
```kconfig
# Cmcc configuration options

config MACH_CMCC_MSM8953
	bool "Cmcc MSM8953"
	depends on ARCH_MSM8953
	help
	  Support for MSM8953 Cmcc variants

menu "Cmcc board selection"

config MACH_CMCC_wt89536
	bool "wt89536 board"
	select MACH_CMCC_MSM8953
	help
	  Support for CMCC M836 wt89536

endmenu
```
